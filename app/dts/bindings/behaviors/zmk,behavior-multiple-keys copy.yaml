## app/dts/bindings/behaviors/zmk,behavior-multiple-keys copy.yaml
```yaml
# Copyright (c) 2022 The ZMK Contributors
# SPDX-License-Identifier: MIT

description: Multiple Keys Behavior

compatible: 'zmk,behavior-multiple-keys'

include: zero_param.yaml

properties:
  bindings:
    type: phandle-array
    required: true
```

## app/dts/bindings/behaviors/zmk,behavior-multiple-keys-select.yaml
```yaml
# Copyright (c) 2022 The ZMK Contributors
# SPDX-License-Identifier: MIT

description: Multiple Keys Select Behavior

compatible: 'zmk,behavior-multiple-keys-select'

include: one_param.yaml
```

## app/dts/bindings/behaviors/zmk,behavior-sys-info.yaml
```yaml
# Copyright (c) 2020 The ZMK Contributors
# SPDX-License-Identifier: MIT

description: Sys Info behavior

compatible: 'zmk,behavior-sys-info'

include: zero_param.yaml
```
